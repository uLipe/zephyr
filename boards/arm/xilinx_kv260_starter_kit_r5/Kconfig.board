## boards/arm/xilinx_kv260_starter_kit_r5/Kconfig.board
```kconfig
# Copyright (c) 2022 Linaro.
# SPDX-License-Identifier: Apache-2.0

config BOARD_KV260_STARTER_KIT_R5
	bool "Xilinx KV260 starter kit R5"
	depends on SOC_XILINX_ZYNQMP_RPU
```

## boards/arm/xilinx_kv260_starter_kit_r5/Kconfig.defconfig
```kconfig
# Copyright (c) 2022 Linaro.
# SPDX-License-Identifier: Apache-2.0

if BOARD_KV260_STARTER_KIT_R5

config BUILD_OUTPUT_BIN
	default n

config BOARD
	default "board_kv260_starter_kit_r5"

if USERSPACE

config COMPILER_ISA_THUMB2
	default n

endif

endif # BOARD_KV260_STARTER_KIT_R5
```

## drivers/misc/st_gpu2d/Kconfig
```kconfig
# Copyright (c) 2026 Felipe Neves <ryukokki.felipe@gmail.com>
# SPDX-License-Identifier: Apache-2.0

config ST_GPU2D
	bool "STM32 GPU2D graphics accelerator bring-up driver"
	default y
	depends on DT_HAS_ST_STM32_GPU2D_ENABLED
	help
		This option enables the GPU2D graphics accelerator bring-up
		code, it makes the GPU ready to be consumed by compatible
		specifications drivers like NemaGFX.
```

## dts/bindings/misc/st,stm32-gpu2d.yaml
```yaml
# Copyright (c) 2025 Felipe Neves. Ltd.
# SPDX-License-Identifier: Apache-2.0

description: STM32 GPU2D graphics accelerator

compatible: "st,stm32-gpu2d"

include: [reset-device.yaml, base.yaml]

properties:
  reg:
    required: true

  clocks:
    required: true

  interrupts:
    required: true

  resets:
    required: true
```

## dts/bindings/misc/zephyr,lvgl-gpu-nema.yaml
```yaml
description: |
  LVGL NemaGFX GPU binding

  Example configuration:

  lvgl_vglite {
          compatible = "zephyr,lvgl-gpu-nema";
          gpu = <&gpu2d>;
          variant = "NemaGFX";
          revision = "0";
  };

compatible: "zephyr,lvgl-gpu-nema"

include: zephyr,lvgl-gpu-common.yaml

properties:
  variant:
    type: string
    required: true
    description: GPU2D variant string.

  revision:
    type: string
    required: true
    description: GPU2D variant revision implementation.
```

## samples/modules/lvgl/demos/boards/ek_ra8d1.conf
```kconfig
CONFIG_LV_Z_MEM_POOL_SIZE=245760
CONFIG_LV_DRAW_LAYER_SIMPLE_BUF_SIZE=49152
CONFIG_LV_USE_DRAW_DAVE2D=y
CONFIG_LV_ATTRIBUTE_MEM_ALIGN_SIZE=64
CONFIG_MEMC=y
CONFIG_LV_Z_VDB_CUSTOM_SECTION=y
CONFIG_LV_USE_SYSMON=y
CONFIG_LV_USE_PERF_MONITOR=y
CONFIG_LV_Z_DEMO_BENCHMARK=y
CONFIG_INPUT_QUEUE_MAX_MSGS=1024
CONFIG_INPUT_THREAD_STACK_SIZE=4096
CONFIG_MAIN_STACK_SIZE=16384
```

## soc/xtensa/esp32/Kconfig.defconfig
```kconfig
# ESP32 board configuration

# Copyright (c) 2017 Intel Corporation
# SPDX-License-Identifier: Apache-2.0

if SOC_ESP32

config SOC
	default "esp32"

config IRQ_OFFLOAD_INTNUM
	default 7

config SMP
	default y

if SMP

config SCHED_IPI_SUPPORTED
	default y

config MP_NUM_CPUS
	default 2

if WIFI_ESP32

config NET_TC_SKIP_FOR_HIGH_PRIO
	default y

config SYSTEM_WORKQUEUE_PRIORITY
	default 4

config NET_TX_DEFAULT_PRIORITY
	default 5

config NET_RX_DEFAULT_PRIORITY
	default 4

config NET_TC_RX_COUNT
	default 0

endif

endif

config MINIMAL_LIBC_OPTIMIZE_STRING_FOR_SIZE
	default n

config LOG_DETECT_MISSED_STRDUP
	default n

endif
```
